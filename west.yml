## west.yml
```yaml
# Copyright (c) 2023 Nordic Semiconductor ASA
# SPDX-License-Identifier: Apache-2.0

manifest:
  self:
    west-commands: scripts/west-commands.yml

  remotes:
    - name: ncs
      url-base: https://github.com/nrfconnect
    - name: sebastiandraus
      url-base: https://github.com/sebastiandraus

  projects:
    - name: nrf
      remote: sebastiandraus
      repo-path: fw-nrfconnect-nrf
      revision: zigbee-fota-xip-three-images
      import: true

  self:
    path: nrf5340_qspi_xip_manifest
```
